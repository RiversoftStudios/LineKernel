## Kconfig.template
```kconfig
# SPDX-License-Identifier: GPL-3.0-or-later
# SPDX-FileCopyrightText: Copyright (C) 2026 Riversoft Studios

mainmenu "LineKernel/{ARCH} {VERSION} Configuration"

source "kernel/Kconfig"

source "{ARCH}/Kconfig"
```

## i386/Kconfig
```kconfig
# SPDX-License-Identifier: GPL-3.0-or-later
# SPDX-FileCopyrightText: Copyright (C) 2026 Riversoft Studios

source "x86/Kconfig"

menu "Console"
    depends on CONSOLE

config VGA_CONSOLE
    bool "vga console"
    default y
    help
      Enable VGA console?

choice
    prompt "Cursor type"
    default CURSOR_SMALL
    help
      Choose how your cursor should look like.
    depends on VGA_CONSOLE

config CURSOR_SMALL
    bool "cursor at the bottom"

config CURSOR_FULL
    bool "cursor takes up full"

endchoice

config SERIAL_CONSOLE
    bool "serial console"
    default y
    help
      Enable serial console?

config PS2_KEYBOARD
    bool "ps2 keyboard"
    default y
    help
      Enable PS/2 keyboard support?

endmenu

menu "Storage"
    depends on DRIVE

config FLOPPY
    bool "floppy drive support"
    default y
    help
      Enable support for x86 Floppy Disk Controllers (FDC).

endmenu
```

## kernel/Kconfig
```kconfig
# SPDX-License-Identifier: GPL-3.0-or-later
# SPDX-FileCopyrightText: Copyright (C) 2026 Riversoft Studios

config DRIVE
    bool "storage drives"
    default y
    help
      Enable storage drives?

menu "Filesystems"
    depends on DRIVE

config FAT12
    bool "fat12 filesystem"
    default y
    help
      Enable FAT12 filesystem?

endmenu

config CONSOLE
    bool "console support"
    default y
    help
      Enable console support?
```

## riscv64/Kconfig
```kconfig
# SPDX-License-Identifier: GPL-3.0-or-later
# SPDX-FileCopyrightText: Copyright (C) 2026 Riversoft Studios

choice
    prompt "Machine"
    default VIRT_MACHINE
    help
      Choose your machine.

config VIRT_MACHINE
    bool "virtual machine"

endchoice
```

## x86_64/Kconfig
```kconfig
# SPDX-License-Identifier: GPL-3.0-or-later
# SPDX-FileCopyrightText: Copyright (C) 2026 Riversoft Studios

source "x86/Kconfig"

menu "Console"
    depends on CONSOLE

config SERIAL_CONSOLE
    bool "serial console"
    default y
    help
      Enable serial console?

config PS2_KEYBOARD
    bool "ps2 keyboard"
    default y
    help
      Enable PS/2 keyboard support?

endmenu
```

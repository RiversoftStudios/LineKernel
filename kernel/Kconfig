## kernel/Kconfig
```kconfig
# SPDX-License-Identifier: GPL-3.0-or-later
# SPDX-FileCopyrightText: Copyright (C) 2026 Riversoft Studios

config DRIVE
    bool "storage drives"
    default y
    help
      Enable storage drives?

menu "Filesystems"
    depends on DRIVE

config FAT12
    bool "fat12 filesystem"
    default y
    help
      Enable FAT12 filesystem?

endmenu

config ELF
    bool "elf support"
    default y
    help
      Enable ELF executable support?
```
